## arch/arm64/configs/vendor/sm8650_defconfig
```kconfig
# SM8650 platform configuration
CONFIG_LOCALVERSION="-sm8650"
CONFIG_ARCH_QCOM=y
CONFIG_ARCH_SM8650=y

# Platform
CONFIG_ARCH_KALAMA=y
CONFIG_ARCH_QTI_VM=y

# OnePlus 13R
CONFIG_ONEPLUS_13R=y
CONFIG_MACH_ONEPLUS_13R=y

# CPU configuration
CONFIG_ARM64=y
CONFIG_64BIT=y
CONFIG_SMP=y
CONFIG_NR_CPUS=8
CONFIG_ARM64_VA_BITS_48=y
CONFIG_SCHED_MC=y
CONFIG_SCHED_SMT=y
CONFIG_ARCH_SUPPORTS_ATOMIC_RMW=y
CONFIG_ARCH_SUPPORTS_INT128=y
CONFIG_ARCH_SUPPORTS_NUMA=y
CONFIG_ARCH_SUPPORTS_SHADOW_CALL_STACK=y
CONFIG_ARM64_4K_PAGES=y
CONFIG_ARM64_AMU_EXTN=y
CONFIG_ARM64_BTI=y
CONFIG_ARM64_BTI_KERNEL=y
CONFIG_ARM64_CRYPTO=y
CONFIG_ARM64_EPAN=y
CONFIG_ARM64_ERRATUM_1742098=y
CONFIG_ARM64_ERRATUM_2051678=y
CONFIG_ARM64_ERRATUM_2077057=y
CONFIG_ARM64_ERRATUM_2441007=y
CONFIG_ARM64_HW_AFDBM=y
CONFIG_ARM64_LD_HAS_FIX_ERRATUM_843419=y
CONFIG_ARM64_MTE=y
CONFIG_ARM64_PAGE_SHIFT=12
CONFIG_ARM64_PA_BITS=48
CONFIG_ARM64_PA_BITS_48=y
CONFIG_ARM64_PTR_AUTH=y
CONFIG_ARM64_PTR_AUTH_KERNEL=y
CONFIG_ARM64_SVE=y
CONFIG_ARM64_TAGGED_ADDR_ABI=y
CONFIG_ARM64_VA_BITS=48
CONFIG_ARM64_VA_BITS_48=y
CONFIG_ARM64_WORKAROUND_CLEAN_CACHE=y
CONFIG_ARM64_WORKAROUND_REPEAT_TLBI=y
CONFIG_ARM64_WORKAROUND_SPECULATIVE_AT=y

# Memory management
CONFIG_MEMORY_HOTPLUG=y
CONFIG_MEMORY_HOTPLUG_DEFAULT_ONLINE=y
CONFIG_MEMORY_HOTPLUG_MOVABLE_NODE=y
CONFIG_MEMORY_HOTREMOVE=y
CONFIG_MEMORY_ISOLATION=y
CONFIG_MEMORY_FAILURE=y
CONFIG_TRANSPARENT_HUGEPAGE=y
CONFIG_TRANSPARENT_HUGEPAGE_ALWAYS=y
CONFIG_CLEANCACHE=y
CONFIG_FRONTSWAP=y
CONFIG_ZSWAP=y
CONFIG_ZPOOL=y
CONFIG_ZBUD=y
CONFIG_Z3FOLD=y
CONFIG_ZSMALLOC=y
CONFIG_PROCESS_RECLAIM=y
CONFIG_ZRAM=y
CONFIG_ZRAM_WRITEBACK=y
CONFIG_PGTABLE_MAPPING=y
CONFIG_BOUNCE=y
CONFIG_CMA=y
CONFIG_CMA_AREAS=7
CONFIG_CMA_DEBUG=y
CONFIG_CMA_DEBUGFS=y
CONFIG_DMA_CMA=y

# Storage
CONFIG_F2FS_FS=y
CONFIG_F2FS_FS_SECURITY=y
CONFIG_F2FS_FS_ENCRYPTION=y
CONFIG_F2FS_FS_COMPRESSION=y

# Display
CONFIG_DRM=y
CONFIG_DRM_MSM=y
CONFIG_DRM_MSM_SDE=y
CONFIG_DRM_MSM_DP=y
CONFIG_DRM_MSM_DP_MST=y
CONFIG_DRM_SDE_RSC=y
CONFIG_DRM_SDE_WB=y
CONFIG_DRM_DISPLAY_MANAGER=y
CONFIG_BACKLIGHT_CLASS_DEVICE=y
CONFIG_BACKLIGHT_LCD_SUPPORT=y
CONFIG_BACKLIGHT_QCOM_SPMI_WLED=y
CONFIG_SYNC_FILE=y
CONFIG_QCOM_MDSS_PLL=y

# Input
CONFIG_INPUT_TOUCHSCREEN=y
CONFIG_TOUCHSCREEN_ONEPLUS=y
CONFIG_TOUCHSCREEN_GOODIX_GTX8=y
CONFIG_TOUCHSCREEN_GOODIX_GTX8_UPDATE=y
CONFIG_TOUCHSCREEN_GOODIX_GTX8_GESTURE=y
CONFIG_TOUCHSCREEN_GOODIX_GTX8_TOOLS=y
CONFIG_INPUT_FINGERPRINT=y
CONFIG_FINGERPRINT_GOODIX_OPTICAL=y

# Power
CONFIG_QPNP_SMB5=y
CONFIG_QPNP_QG=y
CONFIG_QPNP_ADAPTIVE_CHARGE=y
CONFIG_POWER_RESET_QCOM=y
CONFIG_POWER_RESET_QCOM_PON=y
CONFIG_POWER_RESET_QCOM_DOWNLOAD_MODE=y
CONFIG_POWER_RESET_QCOM_DOWNLOAD_MODE_DEFAULT=y
CONFIG_ONEPLUS_FASTCHG=y

# Camera
CONFIG_QCOM_CAMERA_DEBUG=y
CONFIG_MSM_CAMERA=y
CONFIG_MSM_CAMERA_SENSOR=y
CONFIG_MSM_CAMERA_ISP=y

# Security
CONFIG_SECURITY=y
CONFIG_SECURITY_NETWORK=y
CONFIG_SECURITY_SELINUX=y
CONFIG_SECURITY_SELINUX_DEVELOP=y
CONFIG_SECURITY_SELINUX_BOOTPARAM=y
CONFIG_SECURITY_SELINUX_DISABLE=y
CONFIG_SECURITY_SELINUX_AVC_STATS=y
CONFIG_SECURITY_SELINUX_CHECKREQPROT_VALUE=1
CONFIG_DEFAULT_SECURITY_SELINUX=y
CONFIG_CRYPTO_AUTHENC=y
CONFIG_CRYPTO_CBC=y
CONFIG_CRYPTO_ECB=y
CONFIG_CRYPTO_HMAC=y
CONFIG_CRYPTO_MD5=y
CONFIG_CRYPTO_SHA1=y
CONFIG_CRYPTO_SHA256=y
CONFIG_CRYPTO_SHA512=y
CONFIG_CRYPTO_AES=y
CONFIG_CRYPTO_AES_ARM64_CE=y
CONFIG_CRYPTO_AES_ARM64_CE_BLK=y
CONFIG_CRYPTO_AES_ARM64_NEON_BLK=y
CONFIG_CRYPTO_CHACHA20=y
CONFIG_CRYPTO_CHACHA20_NEON=y
CONFIG_CRYPTO_POLY1305=y
CONFIG_CRYPTO_POLY1305_NEON=y
CONFIG_CRYPTO_GHASH_ARM64_CE=y

# Debugging
CONFIG_DYNAMIC_DEBUG=y
CONFIG_DEBUG_INFO=y
CONFIG_DEBUG_INFO_DWARF4=y
CONFIG_DEBUG_INFO_REDUCED=n
CONFIG_DEBUG_INFO_SPLIT=n
CONFIG_DEBUG_INFO_BTF=y
CONFIG_GDB_SCRIPTS=y
CONFIG_FRAME_WARN=2048
CONFIG_MAGIC_SYSRQ=y
CONFIG_DEBUG_KERNEL=y
CONFIG_DEBUG_PAGEALLOC=y
CONFIG_DEBUG_PAGEALLOC_ENABLE_DEFAULT=y
CONFIG_DEBUG_STACK_USAGE=y
CONFIG_DEBUG_MEMORY_INIT=y
CONFIG_DEBUG_STACKOVERFLOW=y
CONFIG_DEBUG_SHIRQ=y
CONFIG_DEBUG_MUTEXES=y
CONFIG_DEBUG_SPINLOCK=y
CONFIG_DEBUG_ATOMIC_SLEEP=y
CONFIG_DEBUG_LIST=y
CONFIG_DETECT_HUNG_TASK=y
CONFIG_DEFAULT_HUNG_TASK_TIMEOUT=120
CONFIG_BOOTPARAM_HUNG_TASK_PANIC=y
CONFIG_WQ_WATCHDOG=y

# Fingerprint
CONFIG_ONEPLUS_FINGERPRINT=y
CONFIG_ONEPLUS_FINGERPRINT_GOODIX=y
CONFIG_ONEPLUS_FINGERPRINT_ENABLE_DRIVER=y

# Alert Slider
CONFIG_ONEPLUS_TRI_STATE_KEY=y

# USB
CONFIG_USB_CONFIGFS=y
CONFIG_USB_CONFIGFS_F_FS=y
CONFIG_USB_CONFIGFS_F_MTP=y
CONFIG_USB_CONFIGFS_F_PTP=y
CONFIG_USB_CONFIGFS_F_ACC=y
CONFIG_USB_CONFIGFS_F_AUDIO_SRC=y
CONFIG_USB_CONFIGFS_UEVENT=y
CONFIG_USB_CONFIGFS_F_UAC2=y
CONFIG_USB_CONFIGFS_F_MIDI=y
CONFIG_USB_CONFIGFS_F_HID=y
CONFIG_USB_CONFIGFS_F_DIAG=y
CONFIG_USB_CONFIGFS_F_CDEV=y
CONFIG_USB_CONFIGFS_F_CCID=y
CONFIG_USB_CONFIGFS_F_GSI=y
CONFIG_USB_CONFIGFS_F_QDSS=y
CONFIG_USB_DWC3=y
CONFIG_USB_DWC3_MSM=y
CONFIG_USB_EHCI_HCD=y
CONFIG_USB_EHCI_HCD_PLATFORM=y
CONFIG_USB_GADGET=y
CONFIG_USB_GADGET_VBUS_DRAW=500

# WiFi
CONFIG_CNSS2=y
CONFIG_CNSS2_QMI=y
CONFIG_CNSS_GENL=y
CONFIG_WCNSS_MEM_PRE_ALLOC=y
CONFIG_CLD_LL_CORE=y
CONFIG_CNSS_UTILS=y
CONFIG_CNSS_QMI_SVC=y
CONFIG_CNSS_PLAT_IPC_QMI_SVC=y
CONFIG_WCNSS_CORE=y
CONFIG_WCNSS_CORE_PRONTO=y
CONFIG_WCNSS_REGISTER_DUMP_ON_BITE=y

# Bluetooth
CONFIG_BT=y
CONFIG_BT_BREDR=y
CONFIG_BT_LE=y
CONFIG_BT_DEBUGFS=y
CONFIG_BT_HCIUART=y
CONFIG_BT_HCIUART_QCA=y
CONFIG_BT_HCIUART_SERDEV=y
CONFIG_BT_QCA_ROME_DOWNLOAD=y
CONFIG_MSM_BT_POWER=y

# NFC
CONFIG_NFC_QTI_I2C=y
CONFIG_NFC_PN553_DEVICES=y

# Debugging
CONFIG_QCOM_MINIDUMP=y
CONFIG_QCOM_RAMDUMP=y 
```

## drivers/oneplus/13r/Kconfig
```kconfig
# OnePlus 13R specific drivers

config ONEPLUS_13R
    bool "OnePlus 13R specific drivers"
    default y
    help
      Enable OnePlus 13R specific drivers

config ONEPLUS_13R_FINGERPRINT
    bool "OnePlus 13R Fingerprint driver"
    default y
    help
      Enable OnePlus 13R fingerprint driver

config ONEPLUS_13R_TOUCHSCREEN
    bool "OnePlus 13R Touchscreen driver"
    default y
    help
      Enable OnePlus 13R touchscreen driver

config ONEPLUS_13R_DISPLAY
    bool "OnePlus 13R Display driver"
    default y
    help
      Enable OnePlus 13R display driver

config ONEPLUS_13R_CAMERA
    bool "OnePlus 13R Camera driver"
    default y
    help
      Enable OnePlus 13R camera driver

config ONEPLUS_13R_BATTERY
    bool "OnePlus 13R Battery driver"
    default y
    help
      Enable OnePlus 13R battery driver

config ONEPLUS_13R_CHARGER
    bool "OnePlus 13R Charger driver"
    default y
    help
      Enable OnePlus 13R charger driver

config ONEPLUS_13R_VIBRATOR
    bool "OnePlus 13R Vibrator driver"
    default y
    help
      Enable OnePlus 13R vibrator driver

config ONEPLUS_13R_SENSORS
    bool "OnePlus 13R Sensors driver"
    default y
    help
      Enable OnePlus 13R sensors driver

config ONEPLUS_13R_AUDIO
    bool "OnePlus 13R Audio driver"
    default y
    help
      Enable OnePlus 13R audio driver

config ONEPLUS_13R_NFC
    bool "OnePlus 13R NFC driver"
    default y
    help
      Enable OnePlus 13R NFC driver 
```

## drivers/oneplus/Kconfig
```kconfig
# OnePlus specific drivers configuration

menuconfig ONEPLUS_DRIVERS
	bool "OnePlus device drivers"
	default y
	help
	  Say Y here to enable OnePlus device drivers.
	  This includes device-specific drivers for OnePlus smartphones.
	  If unsure, say Y.

if ONEPLUS_DRIVERS

config ONEPLUS_TRI_STATE_KEY
	tristate "OnePlus Alert Slider support"
	depends on GPIOLIB && INPUT
	default y
	help
	  Say Y here if you want to enable support for the OnePlus Alert Slider.
	  The Alert Slider is a three-position switch that allows users to
	  quickly change between different notification modes.

	  To compile this driver as a module, choose M here.
	  If unsure, say Y.

config ONEPLUS_FASTCHARGE
	tristate "OnePlus SUPERVOOC fast charging support"
	depends on POWER_SUPPLY
	default y
	help
	  Say Y here if you want to enable support for OnePlus SUPERVOOC fast charging.
	  This enables high-speed charging up to 6A with intelligent voltage and
	  temperature monitoring.

	  To compile this driver as a module, choose M here.
	  If unsure, say Y.

config ONEPLUS_FINGERPRINT
	tristate "OnePlus Goodix fingerprint sensor support"
	depends on SPI && INPUT
	default y
	help
	  Say Y here if you want to enable support for the Goodix fingerprint sensor
	  on OnePlus devices. This driver supports fingerprint detection and
	  navigation events.

	  To compile this driver as a module, choose M here.
	  If unsure, say Y.

config ONEPLUS_DISPLAY_FEATURE
    tristate "OnePlus display features"
    depends on DRM_MSM
    default y
    help
      Say Y here to enable OnePlus-specific display features like
      DC dimming, HBM, and MEMC.

config ONEPLUS_MOTOR
    tristate "OnePlus motor control"
    depends on INPUT
    default y
    help
      Say Y here to enable support for the motor control system
      used in OnePlus devices.

config ONEPLUS_WIRELESS_CHARGE
    tristate "OnePlus wireless charging support"
    depends on POWER_SUPPLY
    default y
    help
      Say Y here to enable support for OnePlus wireless charging features.

endif # ONEPLUS_DRIVERS 
```
