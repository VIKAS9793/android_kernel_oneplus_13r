## arch/arm64/configs/oneplus_13r_defconfig
```kconfig
# Platform and Architecture
CONFIG_ARCH_QCOM=y
CONFIG_ARCH_SM8650=y
CONFIG_ARM64=y
CONFIG_64BIT=y
CONFIG_SMP=y

# OnePlus Drivers
CONFIG_ONEPLUS_DRIVERS=y
CONFIG_ONEPLUS_TRI_STATE_KEY=y
CONFIG_ONEPLUS_FASTCHARGE=y
CONFIG_ONEPLUS_FINGERPRINT=y
CONFIG_ONEPLUS_DISPLAY_FEATURE=y
CONFIG_ONEPLUS_MOTOR=y
CONFIG_ONEPLUS_WIRELESS_CHARGE=y

# Required Dependencies
CONFIG_GPIOLIB=y
CONFIG_INPUT=y
CONFIG_INPUT_MISC=y
CONFIG_POWER_SUPPLY=y
CONFIG_SPI=y
CONFIG_DRM=y
CONFIG_DRM_MSM=y

# Power Management
CONFIG_PM=y
CONFIG_PM_SLEEP=y
CONFIG_PM_RUNTIME=y
CONFIG_SUSPEND=y

# GPIO Support
CONFIG_GPIO_SYSFS=y
CONFIG_PINCTRL=y
CONFIG_PINCTRL_SM8650=y

# SPI Support
CONFIG_SPI_MASTER=y
CONFIG_SPI_QUP=y

# Input Device Support
CONFIG_INPUT_EVDEV=y
CONFIG_INPUT_GPIO=y

# Power Supply Class
CONFIG_POWER_SUPPLY=y
CONFIG_BQ2589X_CHARGER=y

# Display and Graphics
CONFIG_DRM=y
CONFIG_DRM_MSM=y
CONFIG_FB=y
CONFIG_FB_MODE_HELPERS=y

# Debugging
CONFIG_DEBUG_FS=y
CONFIG_DEBUG_GPIO=y
CONFIG_DYNAMIC_DEBUG=y

# Security
CONFIG_SECURITY=y
CONFIG_SECURITY_NETWORK=y
CONFIG_CRYPTO=y
CONFIG_CRYPTO_SHA256=y

# File Systems
CONFIG_EXT4_FS=y
CONFIG_F2FS_FS=y
CONFIG_OVERLAY_FS=y

# Misc
CONFIG_QCOM_SMEM=y
CONFIG_QCOM_SCM=y
CONFIG_QCOM_MEMORY_DUMP_V2=y 
```

## arch/arm64/configs/vendor/Kconfig.oneplus
```kconfig
# SPDX-License-Identifier: GPL-2.0-only
#
# Copyright (C) 2024 OnePlus, Inc.
# Author: VIKAS9793 <vikassahani17@gmail.com>
#

config ONEPLUS_13R
	bool "OnePlus 13R"
	depends on ARCH_KALAMA
	help
	  Support for the OnePlus 13R smartphone.

config MACH_ONEPLUS_13R
	bool "OnePlus 13R board"
	depends on ONEPLUS_13R
	help
	  Support for the OnePlus 13R board.

config ONEPLUS_FINGERPRINT
	bool "OnePlus Fingerprint"
	depends on ONEPLUS_13R
	help
	  Support for OnePlus fingerprint sensor.

config ONEPLUS_FINGERPRINT_GOODIX
	bool "Goodix Fingerprint"
	depends on ONEPLUS_FINGERPRINT
	help
	  Support for Goodix fingerprint sensor on OnePlus devices.

config ONEPLUS_FINGERPRINT_ENABLE_DRIVER
	bool "Enable OnePlus Fingerprint Driver"
	depends on ONEPLUS_FINGERPRINT
	help
	  Enable the OnePlus fingerprint driver.

config ONEPLUS_TRI_STATE_KEY
	bool "OnePlus Alert Slider"
	depends on ONEPLUS_13R
	help
	  Support for OnePlus Alert Slider (Tri-state key).

config ONEPLUS_FASTCHG
	bool "OnePlus SUPERVOOC Fast Charging"
	depends on ONEPLUS_13R
	help
	  Support for OnePlus SUPERVOOC fast charging.

config TOUCHSCREEN_ONEPLUS
	bool "OnePlus Touchscreen"
	depends on ONEPLUS_13R
	help
	  Support for OnePlus touchscreen.

config TOUCHSCREEN_GOODIX_GTX8
	bool "Goodix GTX8 Touchscreen"
	depends on TOUCHSCREEN_ONEPLUS
	help
	  Support for Goodix GTX8 touchscreen on OnePlus devices.

config TOUCHSCREEN_GOODIX_GTX8_UPDATE
	bool "Goodix GTX8 Firmware Update"
	depends on TOUCHSCREEN_GOODIX_GTX8
	help
	  Support for Goodix GTX8 touchscreen firmware update.

config TOUCHSCREEN_GOODIX_GTX8_GESTURE
	bool "Goodix GTX8 Gesture Support"
	depends on TOUCHSCREEN_GOODIX_GTX8
	help
	  Support for Goodix GTX8 touchscreen gestures.

config TOUCHSCREEN_GOODIX_GTX8_TOOLS
	bool "Goodix GTX8 Tools"
	depends on TOUCHSCREEN_GOODIX_GTX8
	help
	  Support for Goodix GTX8 touchscreen debugging tools. 
```

## arch/arm64/configs/vendor/kalama_defconfig
```kconfig
# OnePlus 13R Kernel Configuration
# Based on Snapdragon 8 Gen 3 (kalama)

# Platform
CONFIG_ARCH_QCOM=y
CONFIG_ARCH_KALAMA=y
CONFIG_ARCH_ARM64=y
CONFIG_ARM64_4K_PAGES=y
CONFIG_ARM64_VA_BITS_48=y
CONFIG_ARM64_CNP=y
CONFIG_ARM64_PTR_AUTH=y
CONFIG_ARM64_TAGGED_ADDR_ABI=y

# CPU
CONFIG_CPU_FREQ=y
CONFIG_CPU_FREQ_GOV_POWERSAVE=y
CONFIG_CPU_FREQ_GOV_USERSPACE=y
CONFIG_CPU_FREQ_GOV_ONDEMAND=y
CONFIG_CPU_FREQ_GOV_CONSERVATIVE=y
CONFIG_CPU_FREQ_GOV_SCHEDUTIL=y
CONFIG_CPU_FREQ_DEFAULT_GOV_SCHEDUTIL=y

# Memory
CONFIG_HIGHMEM=y
CONFIG_HIGHPTE=y
CONFIG_ARM64_VA_BITS_48=y
CONFIG_ARM64_4K_PAGES=y
CONFIG_ARM64_CNP=y
CONFIG_ARM64_PTR_AUTH=y

# Power Management
CONFIG_PM=y
CONFIG_PM_SLEEP=y
CONFIG_PM_WAKELOCKS=y
CONFIG_PM_DEBUG=y
CONFIG_PM_ADVANCED_DEBUG=y
CONFIG_PM_SLEEP_DEBUG=y
CONFIG_PM_GENERIC_DOMAINS=y
CONFIG_PM_GENERIC_DOMAINS_OF=y
CONFIG_PM_OPP=y
CONFIG_PM_DEVFREQ=y
CONFIG_DEVFREQ_GOV_SIMPLE_ONDEMAND=y
CONFIG_DEVFREQ_GOV_PERFORMANCE=y
CONFIG_DEVFREQ_GOV_POWERSAVE=y
CONFIG_DEVFREQ_GOV_USERSPACE=y
CONFIG_DEVFREQ_GOV_PASSIVE=y

# Display
CONFIG_DRM=y
CONFIG_DRM_MSM=y
CONFIG_DRM_MSM_DSI=y
CONFIG_DRM_MSM_DP=y
CONFIG_DRM_MSM_DP_MST=y
CONFIG_DRM_MSM_DSI_28NM_PHY=y
CONFIG_DRM_MSM_DSI_20NM_PHY=y
CONFIG_DRM_MSM_DSI_28NM_8960_PHY=y
CONFIG_DRM_MSM_DSI_14NM_PHY=y
CONFIG_DRM_MSM_DSI_10NM_PHY=y
CONFIG_DRM_MSM_DSI_7NM_PHY=y

# Camera
CONFIG_VIDEO_DEV=y
CONFIG_VIDEO_V4L2=y
CONFIG_VIDEOBUF2_CORE=y
CONFIG_VIDEOBUF2_MEMOPS=y
CONFIG_VIDEOBUF2_VMALLOC=y
CONFIG_V4L2_MEM2MEM_DEV=y
CONFIG_VIDEO_QCOM_CAMSS=y
CONFIG_VIDEO_QCOM_VENUS=y

# Audio
CONFIG_SOUND=y
CONFIG_SND=y
CONFIG_SND_SOC=y
CONFIG_SND_SOC_QCOM=y
CONFIG_SND_SOC_SDM845=y
CONFIG_SND_SOC_WCD934X=y
CONFIG_SND_SOC_WCD9335=y
CONFIG_SND_SOC_WSA881X=y
CONFIG_SND_SOC_WCD9XXX_V2=y

# Network
CONFIG_NET=y
CONFIG_PACKET=y
CONFIG_UNIX=y
CONFIG_INET=y
CONFIG_IPV6=y
CONFIG_NETWORK_SECMARK=y
CONFIG_NETFILTER=y
CONFIG_NETFILTER_ADVANCED=y
CONFIG_NF_CONNTRACK=y
CONFIG_NF_CONNTRACK_SECMARK=y
CONFIG_NF_CT_PROTO_DCCP=y
CONFIG_NF_CT_PROTO_SCTP=y
CONFIG_NF_CT_PROTO_UDPLITE=y
CONFIG_NF_CONNTRACK_EVENTS=y
CONFIG_NF_CONNTRACK_TIMEOUT=y
CONFIG_NF_CONNTRACK_TIMESTAMP=y
CONFIG_NF_CT_PROTO_DCCP=y
CONFIG_NF_CT_PROTO_SCTP=y
CONFIG_NF_CT_PROTO_UDPLITE=y

# Security
CONFIG_SECURITY=y
CONFIG_SECURITY_SELINUX=y
CONFIG_SECURITY_SELINUX_BOOTPARAM=y
CONFIG_SECURITY_SELINUX_DEVELOP=y
CONFIG_SECURITY_SELINUX_AVC_STATS=y
CONFIG_SECURITY_SELINUX_CHECKREQPROT_VALUE=1
CONFIG_SECURITY_SELINUX_SIDTAB_HASH_BITS=9
CONFIG_SECURITY_SELINUX_SID2STR_CACHE_SIZE=256
CONFIG_SECURITY_SELINUX_AVC_STATS=y
CONFIG_SECURITY_SELINUX_CHECKREQPROT_VALUE=1
CONFIG_SECURITY_SELINUX_SIDTAB_HASH_BITS=9
CONFIG_SECURITY_SELINUX_SID2STR_CACHE_SIZE=256

# Filesystem
CONFIG_EXT4_FS=y
CONFIG_EXT4_FS_POSIX_ACL=y
CONFIG_EXT4_FS_SECURITY=y
CONFIG_F2FS_FS=y
CONFIG_F2FS_FS_XATTR=y
CONFIG_F2FS_FS_POSIX_ACL=y
CONFIG_F2FS_FS_SECURITY=y
CONFIG_F2FS_CHECK_FS=y
CONFIG_F2FS_IO_TRACE=y
CONFIG_F2FS_FAULT_INJECTION=y

# Debugging
CONFIG_DEBUG_FS=y
CONFIG_DEBUG_KERNEL=y
CONFIG_DEBUG_SG=y
CONFIG_DEBUG_VM=y
CONFIG_DEBUG_VIRTUAL=y
CONFIG_DEBUG_MEMORY_INIT=y
CONFIG_DEBUG_LIST=y
CONFIG_DEBUG_PLIST=y
CONFIG_DEBUG_SG=y
CONFIG_DEBUG_VM=y
CONFIG_DEBUG_VIRTUAL=y
CONFIG_DEBUG_MEMORY_INIT=y
CONFIG_DEBUG_LIST=y
CONFIG_DEBUG_PLIST=y

# OnePlus 13R Specific Features
CONFIG_ONEPLUS_13R=y
CONFIG_ONEPLUS_FASTCHG=y
CONFIG_ONEPLUS_WIRELESS_CHARGE=y
CONFIG_ONEPLUS_DISPLAY=y
CONFIG_ONEPLUS_FINGERPRINT=y
CONFIG_ONEPLUS_ALERT_SLIDER=y
CONFIG_ONEPLUS_TRI_STATE_KEY=y
CONFIG_ONEPLUS_VIBRATOR=y
CONFIG_ONEPLUS_POWER=y

# Display Configuration
CONFIG_DRM_PANEL_SAMSUNG_S6E3FC3=y
CONFIG_DRM_PANEL_SAMSUNG_ANA6705=y
CONFIG_DRM_MSM=y
CONFIG_DRM_MSM_SDE=y
CONFIG_DRM_MSM_DSI=y
CONFIG_DRM_MSM_DP=y

# Touch Panel
CONFIG_TOUCHSCREEN_GOODIX_GTX8=y
CONFIG_TOUCHSCREEN_GOODIX_TS_TOOLS=y
CONFIG_TOUCHSCREEN_GOODIX_TS_GESTURE=y

# Power Supply
CONFIG_QPNP_SMB5=y
CONFIG_QPNP_QNOVO5=y
CONFIG_QPNP_FG_GEN4=y
CONFIG_SMB1398_CHARGER=y
CONFIG_SMB1355_SLAVE_CHARGER=y
CONFIG_BQ27541_OPPO_BATTERY=y

# USB Type-C
CONFIG_TYPEC=y
CONFIG_TYPEC_TCPM=y
CONFIG_TYPEC_UCSI=y
CONFIG_TCPC_CLASS=y
CONFIG_USB_POWER_DELIVERY=y
CONFIG_TCPC_RT1711H=y

# Fingerprint
CONFIG_FINGERPRINT_GOODIX_OPTICAL=y
CONFIG_FINGERPRINT_GOODIX_FOD=y

# Camera
CONFIG_ONEPLUS_CAMERA=y
CONFIG_MSM_CAMERA=y
CONFIG_SPECTRA_CAMERA=y
CONFIG_MSM_JPEGDMA=y
CONFIG_MSM_ISPIF=y

# Audio
CONFIG_SND_SOC_TFA9894=y
CONFIG_SND_SOC_MAX98927=y
CONFIG_SND_SOC_CS35L41=y

# Sensors
CONFIG_SENSORS_SSC=y
CONFIG_SENSORS_SX9324=y
CONFIG_SENSORS_BMI26X=y
CONFIG_SENSORS_AK0991X=y

# Additional OnePlus Features
CONFIG_ONEPLUS_HEALTHINFO=y
CONFIG_ONEPLUS_MEMPLUS=y
CONFIG_ONEPLUS_FG_OPT=y
CONFIG_ONEPLUS_SMART_CHARGE=y

# GPU Configuration
CONFIG_MSM_KGSL=y
CONFIG_MSM_KGSL_IOMMU=y
CONFIG_MSM_KGSL_IOMMU_GPU=y
CONFIG_MSM_KGSL_IOMMU_CPU=y
CONFIG_MSM_KGSL_IOMMU_GPU_SYNC=y
CONFIG_MSM_KGSL_IOMMU_GPU_UNSYNC=y

# Display Configuration
CONFIG_DRM_MSM=y
CONFIG_DRM_MSM_DSI=y
CONFIG_DRM_MSM_DSI_28NM=y
CONFIG_DRM_MSM_DSI_20NM=y
CONFIG_DRM_MSM_DSI_10NM=y
CONFIG_DRM_MSM_DSI_10NM_PHY=y
CONFIG_DRM_MSM_DSI_10NM_PHY_V2=y
CONFIG_DRM_MSM_DSI_10NM_PHY_V3=y
CONFIG_DRM_MSM_DSI_10NM_PHY_V4=y
CONFIG_DRM_MSM_DSI_10NM_PHY_V5=y
CONFIG_DRM_MSM_DSI_10NM_PHY_V6=y
CONFIG_DRM_MSM_DSI_10NM_PHY_V7=y
CONFIG_DRM_MSM_DSI_10NM_PHY_V8=y
CONFIG_DRM_MSM_DSI_10NM_PHY_V9=y
CONFIG_DRM_MSM_DSI_10NM_PHY_V10=y

# Camera Configuration
CONFIG_MSM_CAMERA=y
CONFIG_MSM_CAMERA_SENSOR=y
CONFIG_MSM_CAMERA_SENSOR_DRIVER=y
CONFIG_MSM_CAMERA_SENSOR_DRIVER_V2=y
CONFIG_MSM_CAMERA_SENSOR_DRIVER_V3=y
CONFIG_MSM_CAMERA_SENSOR_DRIVER_V4=y
CONFIG_MSM_CAMERA_SENSOR_DRIVER_V5=y
CONFIG_MSM_CAMERA_SENSOR_DRIVER_V6=y
CONFIG_MSM_CAMERA_SENSOR_DRIVER_V7=y
CONFIG_MSM_CAMERA_SENSOR_DRIVER_V8=y
CONFIG_MSM_CAMERA_SENSOR_DRIVER_V9=y
CONFIG_MSM_CAMERA_SENSOR_DRIVER_V10=y

# Audio Configuration
CONFIG_SND_SOC_MSM_QDSP6V2=y
CONFIG_SND_SOC_MSM_QDSP6V2_VM=y
CONFIG_SND_SOC_MSM_QDSP6V2_VM_DAI=y
CONFIG_SND_SOC_MSM_QDSP6V2_VM_DAI_V2=y
CONFIG_SND_SOC_MSM_QDSP6V2_VM_DAI_V3=y
CONFIG_SND_SOC_MSM_QDSP6V2_VM_DAI_V4=y
CONFIG_SND_SOC_MSM_QDSP6V2_VM_DAI_V5=y
CONFIG_SND_SOC_MSM_QDSP6V2_VM_DAI_V6=y
CONFIG_SND_SOC_MSM_QDSP6V2_VM_DAI_V7=y
CONFIG_SND_SOC_MSM_QDSP6V2_VM_DAI_V8=y
CONFIG_SND_SOC_MSM_QDSP6V2_VM_DAI_V9=y
CONFIG_SND_SOC_MSM_QDSP6V2_VM_DAI_V10=y

# WiFi Configuration
CONFIG_CFG80211=y
CONFIG_CFG80211_WEXT=y
CONFIG_CFG80211_INTERNAL_REGDB=y
CONFIG_CFG80211_CRDA_SUPPORT=y
CONFIG_CFG80211_WEXT_EXPORT=y
CONFIG_CFG80211_DEFAULT_PS=y
CONFIG_CFG80211_DEBUGFS=y
CONFIG_CFG80211_INTERNAL_REGDB=y
CONFIG_CFG80211_CRDA_SUPPORT=y
CONFIG_CFG80211_WEXT_EXPORT=y
CONFIG_CFG80211_DEFAULT_PS=y
CONFIG_CFG80211_DEBUGFS=y

# Bluetooth Configuration
CONFIG_BT=y
CONFIG_BT_RFCOMM=y
CONFIG_BT_BNEP=y
CONFIG_BT_HS=y
CONFIG_BT_LE=y
CONFIG_BT_LE_6LOWPAN=y
CONFIG_BT_LE_L2CAP_ECRED=y
CONFIG_BT_LE_L2CAP_ECRED_DEBUGFS=y
CONFIG_BT_LE_L2CAP_ECRED_DEBUGFS_V2=y
CONFIG_BT_LE_L2CAP_ECRED_DEBUGFS_V3=y
CONFIG_BT_LE_L2CAP_ECRED_DEBUGFS_V4=y
CONFIG_BT_LE_L2CAP_ECRED_DEBUGFS_V5=y
CONFIG_BT_LE_L2CAP_ECRED_DEBUGFS_V6=y
CONFIG_BT_LE_L2CAP_ECRED_DEBUGFS_V7=y
CONFIG_BT_LE_L2CAP_ECRED_DEBUGFS_V8=y
CONFIG_BT_LE_L2CAP_ECRED_DEBUGFS_V9=y
CONFIG_BT_LE_L2CAP_ECRED_DEBUGFS_V10=y

# USB Configuration
CONFIG_USB_SUPPORT=y
CONFIG_USB_XHCI_HCD=y
CONFIG_USB_XHCI_PLATFORM=y
CONFIG_USB_XHCI_HCD_DEBUGFS=y
CONFIG_USB_XHCI_HCD_DEBUGFS_V2=y
CONFIG_USB_XHCI_HCD_DEBUGFS_V3=y
CONFIG_USB_XHCI_HCD_DEBUGFS_V4=y
CONFIG_USB_XHCI_HCD_DEBUGFS_V5=y
CONFIG_USB_XHCI_HCD_DEBUGFS_V6=y
CONFIG_USB_XHCI_HCD_DEBUGFS_V7=y
CONFIG_USB_XHCI_HCD_DEBUGFS_V8=y
CONFIG_USB_XHCI_HCD_DEBUGFS_V9=y
CONFIG_USB_XHCI_HCD_DEBUGFS_V10=y

# Power Management
CONFIG_PM=y
CONFIG_PM_SLEEP=y
CONFIG_PM_SLEEP_SMP=y
CONFIG_PM_SLEEP_SMP_V2=y
CONFIG_PM_SLEEP_SMP_V3=y
CONFIG_PM_SLEEP_SMP_V4=y
CONFIG_PM_SLEEP_SMP_V5=y
CONFIG_PM_SLEEP_SMP_V6=y
CONFIG_PM_SLEEP_SMP_V7=y
CONFIG_PM_SLEEP_SMP_V8=y
CONFIG_PM_SLEEP_SMP_V9=y
CONFIG_PM_SLEEP_SMP_V10=y

# Thermal Management
CONFIG_THERMAL=y
CONFIG_THERMAL_OF=y
CONFIG_THERMAL_WRITABLE_TRIPS=y
CONFIG_THERMAL_DEFAULT_GOV_STEP_WISE=y
CONFIG_THERMAL_DEFAULT_GOV_FAIR_SHARE=y
CONFIG_THERMAL_DEFAULT_GOV_USER_SPACE=y
CONFIG_THERMAL_DEFAULT_GOV_POWER_ALLOCATOR=y
CONFIG_THERMAL_DEFAULT_GOV_BANG_BANG=y
CONFIG_THERMAL_DEFAULT_GOV_STEP_WISE_V2=y
CONFIG_THERMAL_DEFAULT_GOV_FAIR_SHARE_V2=y
CONFIG_THERMAL_DEFAULT_GOV_USER_SPACE_V2=y
CONFIG_THERMAL_DEFAULT_GOV_POWER_ALLOCATOR_V2=y
CONFIG_THERMAL_DEFAULT_GOV_BANG_BANG_V2=y 
```
