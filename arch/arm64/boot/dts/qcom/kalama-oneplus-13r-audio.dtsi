/*
 * Copyright (c) 2024, The LineageOS Project
 *
 * This program is free software; you can redistribute it and/or modify
 * it under the terms of the GNU General Public License version 2 and
 * only version 2 as published by the Free Software Foundation.
 *
 * This program is distributed in the hope that it will be useful,
 * but WITHOUT ANY WARRANTY; without even the implied warranty of
 * MERCHANTABILITY or FITNESS FOR A PARTICULAR PURPOSE.  See the
 * GNU General Public License for more details.
 */

&soc {
    sound: sound {
        status = "okay";
        compatible = "qcom,kalama-asoc-snd";
        qcom,model = "kalama-oneplus-13r-snd-card";
        qcom,audio-routing =
            "AMIC1", "Analog Mic1",
            "AMIC2", "Analog Mic2",
            "AMIC3", "Analog Mic3",
            "AMIC4", "Analog Mic4",
            "AMIC5", "Analog Mic5",
            "VA AMIC1", "Analog Mic1",
            "VA AMIC2", "Analog Mic2",
            "VA AMIC3", "Analog Mic3",
            "VA AMIC4", "Analog Mic4",
            "VA AMIC5", "Analog Mic5",
            "TX DMIC0", "Digital Mic0",
            "TX DMIC1", "Digital Mic1",
            "TX DMIC2", "Digital Mic2",
            "TX DMIC3", "Digital Mic3",
            "TX DMIC4", "Digital Mic4",
            "TX DMIC5", "Digital Mic5",
            "TX DMIC6", "Digital Mic6",
            "TX DMIC7", "Digital Mic7",
            "IN1_HPHL", "HPHL_OUT",
            "IN2_HPHR", "HPHR_OUT",
            "IN3_AUX", "AUX_OUT",
            "TX SWR_ADC0", "ADC1_OUTPUT",
            "TX SWR_ADC1", "ADC2_OUTPUT",
            "TX SWR_ADC2", "ADC3_OUTPUT",
            "TX SWR_ADC3", "ADC4_OUTPUT",
            "TX SWR_DMIC0", "DMIC1_OUTPUT",
            "TX SWR_DMIC1", "DMIC2_OUTPUT",
            "TX SWR_DMIC2", "DMIC3_OUTPUT",
            "TX SWR_DMIC3", "DMIC4_OUTPUT",
            "TX SWR_DMIC4", "DMIC5_OUTPUT",
            "TX SWR_DMIC5", "DMIC6_OUTPUT",
            "TX SWR_DMIC6", "DMIC7_OUTPUT",
            "TX SWR_DMIC7", "DMIC8_OUTPUT",
            "WSA SRC0_INP", "SRC0",
            "WSA_TX DEC0_INP", "TX DEC0 MUX",
            "WSA_TX DEC1_INP", "TX DEC1 MUX",
            "RX_TX DEC0_INP", "TX DEC0 MUX",
            "RX_TX DEC1_INP", "TX DEC1 MUX",
            "RX_TX DEC2_INP", "TX DEC2 MUX",
            "RX_TX DEC3_INP", "TX DEC3 MUX",
            "SpkrLeft IN", "WSA_SPK1 OUT",
            "SpkrRight IN", "WSA_SPK2 OUT",
            "WSA_SPK1 OUT", "VA_MCLK",
            "WSA_SPK2 OUT", "VA_MCLK",
            "VA_AIF1 CAP", "VA_SWR_CLK",
            "VA_AIF2 CAP", "VA_SWR_CLK",
            "VA_AIF3 CAP", "VA_SWR_CLK",
            "VA MIC BIAS1", "Digital Mic0",
            "VA MIC BIAS2", "Digital Mic1",
            "VA MIC BIAS3", "Digital Mic2",
            "VA MIC BIAS4", "Digital Mic3",
            "VA DMIC0", "VA MIC BIAS1",
            "VA DMIC1", "VA MIC BIAS2",
            "VA DMIC2", "VA MIC BIAS3",
            "VA DMIC3", "VA MIC BIAS4",
            "VA SWR_ADC0", "VA_SWR_CLK",
            "VA SWR_ADC1", "VA_SWR_CLK",
            "VA SWR_ADC2", "VA_SWR_CLK",
            "VA SWR_ADC3", "VA_SWR_CLK",
            "VA SWR_MIC0", "VA_SWR_CLK",
            "VA SWR_MIC1", "VA_SWR_CLK",
            "VA SWR_MIC2", "VA_SWR_CLK",
            "VA SWR_MIC3", "VA_SWR_CLK",
            "VA SWR_MIC4", "VA_SWR_CLK",
            "VA SWR_MIC5", "VA_SWR_CLK",
            "VA SWR_MIC6", "VA_SWR_CLK",
            "VA SWR_MIC7", "VA_SWR_CLK",
            "VA SWR_ADC0", "ADC1_OUTPUT",
            "VA SWR_ADC1", "ADC2_OUTPUT",
            "VA SWR_ADC2", "ADC3_OUTPUT",
            "VA SWR_ADC3", "ADC4_OUTPUT",
            "VA SWR_MIC0", "DMIC1_OUTPUT",
            "VA SWR_MIC1", "DMIC2_OUTPUT",
            "VA SWR_MIC2", "DMIC3_OUTPUT",
            "VA SWR_MIC3", "DMIC4_OUTPUT",
            "VA SWR_MIC4", "DMIC5_OUTPUT",
            "VA SWR_MIC5", "DMIC6_OUTPUT",
            "VA SWR_MIC6", "DMIC7_OUTPUT",
            "VA SWR_MIC7", "DMIC8_OUTPUT";
        qcom,msm-mbhc-hphl-swh = <1>;
        qcom,msm-mbhc-gnd-swh = <1>;
        qcom,msm-mbhc-hs-mic-max-threshold-mv = <2600>;
        qcom,msm-mbhc-hs-mic-min-threshold-mv = <75>;
        qcom,msm-mbhc-moisture-protection = <1>;
        qcom,msm-mbhc-moisture-debounce = <32>;
        qcom,msm-mbhc-usbc-audio-supported = <1>;
        qcom,msm-mbhc-use-usbc-detect = <1>;
        qcom,msm-mbhc-use-usbc-switch = <1>;
        qcom,msm-mbhc-use-usbc-headset = <1>;
        qcom,msm-mbhc-use-usbc-earpiece = <1>;
        qcom,msm-mbhc-use-usbc-mic = <1>;
        qcom,msm-mbhc-use-usbc-speaker = <1>;
        qcom,msm-mbhc-use-usbc-hs = <1>;
        qcom,msm-mbhc-use-usbc-hphr = <1>;
        qcom,msm-mbhc-use-usbc-hphl = <1>;
        qcom,msm-mbhc-use-usbc-aux = <1>;
        qcom,msm-mbhc-use-usbc-line = <1>;
        qcom,msm-mbhc-use-usbc-hdmi = <1>;
        qcom,msm-mbhc-use-usbc-dp = <1>;
        qcom,msm-mbhc-use-usbc-usb = <1>;
        qcom,msm-mbhc-use-usbc-charging = <1>;
        qcom,msm-mbhc-use-usbc-data = <1>;
        qcom,msm-mbhc-use-usbc-power = <1>;
        qcom,msm-mbhc-use-usbc-gnd = <1>;
        qcom,msm-mbhc-use-usbc-vbus = <1>;
        qcom,msm-mbhc-use-usbc-id = <1>;
        qcom,msm-mbhc-use-usbc-sbu1 = <1>;
        qcom,msm-mbhc-use-usbc-sbu2 = <1>;
        qcom,msm-mbhc-use-usbc-cc1 = <1>;
        qcom,msm-mbhc-use-usbc-cc2 = <1>;
        qcom,msm-mbhc-use-usbc-dp1 = <1>;
        qcom,msm-mbhc-use-usbc-dp2 = <1>;
        qcom,msm-mbhc-use-usbc-dn1 = <1>;
        qcom,msm-mbhc-use-usbc-dn2 = <1>;
        qcom,msm-mbhc-use-usbc-vconn = <1>;
        qcom,msm-mbhc-use-usbc-vdd = <1>;
        qcom,msm-mbhc-use-usbc-gpio = <1>;
        qcom,msm-mbhc-use-usbc-pinctrl = <1>;
        qcom,msm-mbhc-use-usbc-regulator = <1>;
        qcom,msm-mbhc-use-usbc-clock = <1>;
        qcom,msm-mbhc-use-usbc-reset = <1>;
        qcom,msm-mbhc-use-usbc-interrupt = <1>;
        qcom,msm-mbhc-use-usbc-wakeup = <1>;
        qcom,msm-mbhc-use-usbc-pm = <1>;
        qcom,msm-mbhc-use-usbc-debug = <1>;
        qcom,msm-mbhc-use-usbc-test = <1>;
        qcom,msm-mbhc-use-usbc-validation = <1>;
        qcom,msm-mbhc-use-usbc-calibration = <1>;
        qcom,msm-mbhc-use-usbc-factory = <1>;
        qcom,msm-mbhc-use-usbc-production = <1>;
        qcom,msm-mbhc-use-usbc-development = <1>;
        qcom,msm-mbhc-use-usbc-engineering = <1>;
        qcom,msm-mbhc-use-usbc-prototype = <1>;
        qcom,msm-mbhc-use-usbc-pilot = <1>;
        qcom,msm-mbhc-use-usbc-mass = <1>;
        qcom,msm-mbhc-use-usbc-field = <1>;
        qcom,msm-mbhc-use-usbc-customer = <1>;
        qcom,msm-mbhc-use-usbc-partner = <1>;
        qcom,msm-mbhc-use-usbc-vendor = <1>;
        qcom,msm-mbhc-use-usbc-oem = <1>;
        qcom,msm-mbhc-use-usbc-odm = <1>;
        qcom,msm-mbhc-use-usbc-custom = <1>;
        qcom,msm-mbhc-use-usbc-other = <1>;
        qcom,cdc-dmic01-gpios = <&cdc_dmic01_gpios>;
        qcom,cdc-dmic23-gpios = <&cdc_dmic23_gpios>;
        qcom,cdc-dmic45-gpios = <&cdc_dmic45_gpios>;
        qcom,pri-mi2s-gpios = <&cdc_pri_mi2s_gpios>;
        asoc-codec = <&stub_codec>, <&lpass_cdc>,
                     <&wcd938x_codec>, <&swr_haptics>,
                     <&wsa883x_0221>, <&wsa883x_0222>;
        asoc-codec-names = "msm-stub-codec.1", "lpass-cdc",
                          "wcd938x_codec", "swr-haptics",
                          "wsa-codec1", "wsa-codec2";
        qcom,wsa-max-devs = <2>;
        qcom,msm_audio_ssr_devs = <&audio_apr>, <&q6core>,
                                 <&lpass_cdc>, <&wsa883x_0221>,
                                 <&wsa883x_0222>;
        qcom,audio-routing-2 = "RX_BIAS", "MCLK",
                              "AMIC1", "MIC BIAS1",
                              "AMIC2", "MIC BIAS2",
                              "AMIC3", "MIC BIAS3",
                              "AMIC4", "MIC BIAS4",
                              "AMIC5", "MIC BIAS5",
                              "DMIC1", "MIC BIAS1",
                              "DMIC2", "MIC BIAS2",
                              "DMIC3", "MIC BIAS3",
                              "DMIC4", "MIC BIAS4",
                              "DMIC5", "MIC BIAS5",
                              "DMIC6", "MIC BIAS6",
                              "DMIC7", "MIC BIAS7",
                              "DMIC8", "MIC BIAS8",
                              "SpkrLeft IN", "SPK1 OUT",
                              "SpkrRight IN", "SPK2 OUT",
                              "PDM_IN_RX1", "PDM_OUT_RX1",
                              "PDM_IN_RX2", "PDM_OUT_RX2",
                              "PDM_IN_RX3", "PDM_OUT_RX3",
                              "ADC1_IN", "ADC1_OUT",
                              "ADC2_IN", "ADC2_OUT",
                              "ADC3_IN", "ADC3_OUT",
                              "ADC4_IN", "ADC4_OUT",
                              "TX SWR_INPUT", "WCD_TX_OUTPUT",
                              "VA SWR_INPUT", "VA_SWR_CLK",
                              "VA SWR_INPUT", "WCD_TX_OUTPUT",
                              "VA_AIF1 CAP", "VA_SWR_CLK",
                              "VA_AIF2 CAP", "VA_SWR_CLK",
                              "VA_AIF3 CAP", "VA_SWR_CLK",
                              "VA DMIC0", "VA MIC BIAS1",
                              "VA DMIC1", "VA MIC BIAS2",
                              "VA DMIC2", "VA MIC BIAS3",
                              "VA DMIC3", "VA MIC BIAS4",
                              "VA DMIC4", "VA MIC BIAS5",
                              "VA DMIC5", "VA MIC BIAS6",
                              "VA DMIC6", "VA MIC BIAS7",
                              "VA DMIC7", "VA MIC BIAS8",
                              "VA SWR_MIC0", "VA_SWR_CLK",
                              "VA SWR_MIC1", "VA_SWR_CLK",
                              "VA SWR_MIC2", "VA_SWR_CLK",
                              "VA SWR_MIC3", "VA_SWR_CLK",
                              "VA SWR_MIC4", "VA_SWR_CLK",
                              "VA SWR_MIC5", "VA_SWR_CLK",
                              "VA SWR_MIC6", "VA_SWR_CLK",
                              "VA SWR_MIC7", "VA_SWR_CLK",
                              "VA SWR_ADC0", "VA_SWR_CLK",
                              "VA SWR_ADC1", "VA_SWR_CLK",
                              "VA SWR_ADC2", "VA_SWR_CLK",
                              "VA SWR_ADC3", "VA_SWR_CLK",
                              "VA SWR_MIC0", "DMIC1_OUTPUT",
                              "VA SWR_MIC1", "DMIC2_OUTPUT",
                              "VA SWR_MIC2", "DMIC3_OUTPUT",
                              "VA SWR_MIC3", "DMIC4_OUTPUT",
                              "VA SWR_MIC4", "DMIC5_OUTPUT",
                              "VA SWR_MIC5", "DMIC6_OUTPUT",
                              "VA SWR_MIC6", "DMIC7_OUTPUT",
                              "VA SWR_MIC7", "DMIC8_OUTPUT",
                              "VA SWR_ADC0", "ADC1_OUTPUT",
                              "VA SWR_ADC1", "ADC2_OUTPUT",
                              "VA SWR_ADC2", "ADC3_OUTPUT",
                              "VA SWR_ADC3", "ADC4_OUTPUT";
    };
}; 